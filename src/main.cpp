/*
   Цвето-цветомузыка на Arduino и адресной светодиодной ленте WS2812b
 
   *******************************************************************
   Разработано: AlexGyver
   Страница проекта: http://alexgyver.ru/colormusic/
   GitHub: https://github.com/AlexGyver/ColorMusic

   Доработано: OlegAnadyr
               technotrasher

   Переработано: Slenk

   Отдельная благодарность: Aleksandr1612
   *******************************************************************

   Версия 2.5: 
   
   Данная модификация поддерживает 300 светодиодов.     
   Использует библиотеки: FastLED      - управление лентой
                          IRLremote    - ИК пульт
                          FHT          - преобразование Хартли
                          EEPROMex     - доступ к энергонезависимой памяти
                          GyverButton  - управление кнопками                             
   Библиотеки идут с проектом: https://community.alexgyver.ru/threads/cvetomuzyka-na-arduino.37/post-39347

   Особенности:
    - Плавная анимация (можно настроить)
    - Автонастройка по громкости (можно настроить)
    - Фильтр нижнего шума (можно настроить)
    - Автокалибровка шума при запуске (можно настроить)
    - В режиме частот лента не гаснет полностью (EMPTY_BRIGHT)
    - Все настройки сохраняются в памяти и не сбрасываются при перезагрузке
    - Сохранение настроек происходит при переводе в режим ожидания кнопкой ноль (0)
    - А также через 30 секунд после последнего нажатия на любую кнопку ИК пульта

   Автоматическая настройка нижнего порога шума для режимов цветомузыки ( 4-9 ) раздельно для 4-7 и 8-9
     1 - Включаем систему.
     2 - Выключаем музыку.
     3 - Жмём кнопку OK 4 раза подряд на пульте.
     4 - Значения шумов будут записаны в память и сами загружаться при последующем запуске.

   Ручная настройка нижнего порога шума для режимов цветомузыки ( 4-9 ) раздельно для 4-8 и 9
     1 - Включаем систему.
     2 - Включаем музыку.
     3 - Жмём кнопку OK (включается режим настроек - первые 8 диодов постоянно горят "радугой").
     4 - Кнопаками * / # настраиваем чувствиительность.
     5 - Жмём кнопку OK (выключается режим настроек).

   Сброс настроек в памяти
     1 - Выключаем систему кнопкой ноль (0) - первый диод тускло мигает красным.
     2 - Жмём кнопку OK 4 раза подряд на пульте.
     3 - Система перезагрузится со стандартными настройками.

    Настройка своего пульта:
     1 - Изменить параметр "REMOTE_LOG" с "0" на "1".
     2 - Загрузить скетч.
     3 - Открыть монитор. 
     4 - Нажимаеть кнопки на пульте и записывать их в скетч в нужное место.

   Пульт:
  |------------------------------------------------------------------------------|
  | №  | Режим                         |       Кнопки ⇆     |     Кнопки ⇅     |
  |------------------------------------------------------------------------------|
  | 0   | Режим ожидания                | -                  | -                 |
  |------------------------------------------------------------------------------|
  | 1   | Подсветка одним цветом        |     Кнопки * / # - Смена подрежима     | - повторное нажатие сбрасывает температуру белого
  | 1.1 | Белый свет                    | Температура        | Яркость           |
  | 1.2 | Постоянный цвет               | Цвет               | Насыщенность      |
  | 1.3 | Плавная смета цвета           | Скорость           | Насыщенность      |
  | 1.4 | Пульсация случайным цветом    | Скорость           | Насыщенность      |
  | 1.5 | Резкая смена цвета            | Скорость           | Насыщенность      |
  |------------------------------------------------------------------------------|
  | 2   | Цветовые эффекты              |     Кнопки * / # - Смена подрежима     |
  | 2.1 | Плавная радуга                | Скорость           | Шаг радуги        |
  | 2.2 | Плавная радуга с искрами      | Скорость           | Шаг радуги        |  
  | 2.3 | Случайная вспышка и затухание | Скорость           | Насыщенность      |
  | 2.4 | Случайная смена цветов        | Скорость           | Насыщенность      |
  | 2.5 | Безумие случайных вспышек     | Скорость           | Насыщенность      |
  | 2.6 | Безумие случайных вспышек 2   | Скорость           | Насыщенность      |
  | 2.7 | Конфетти                      | Скорость           | Насыщенность      |
  | 2.8 | Бегающая точка со следами     | Скорость           | Насыщенность      |
  | 2.9 | Пульсирующие цветные полосы   | Скорость           | -                 |
  | 2.10| 8 сплетающихся цветных точек  | -                  | Насыщенность      |  
  | 2.11| Огонь в центр                 | Скорость           | Цвет              |
  | 2.12| Лёд и Пламень                 | Скорость           | Цвет              |
  | 2.13| Огонь                         | Скорость           | Цвет              |
  | 2.14| Лава                          | Скорость           | Цвет              |
  | 2.15| Облака                        | Скорость           | Цвет              |
  | 2.16| Бассейн                       | Скорость           | Цвет              |
  | 2.17| Лес                           | Скорость           | Цвет              |
  | 2.18| Плазма                        | Скорость           | Цвет              |
  | 2.19| Зебра                         | Скорость           | Цвет              |
  |------------------------------------------------------------------------------|
  | 6   | Стробоскоп                    |       Кнопки * / # - Смена цвета       |  
  |  повторное нажатие - белый/цветной  | Плавность вспышек  | Частота вспышек   |
  |------------------------------------------------------------------------------|
  | 4   | Цветомузыка (1 полоса)        | Плавность анимации | Чувствительность  |
  |------------------------------------------------------------------------------|
  | 5   | Бегущие частоты               |     Кнопки * / # - Смена подрежима     |
  | 5.1 | 3 частоты                     | Скорость           | Чувствительность  |
  | 5.2 | Низкие                        | Скорость           | Чувствительность  |
  | 5.3 | Средние                       | Скорость           | Чувствительность  |
  | 5.4 | Высокие                       | Скорость           | Чувствительность  |
  |------------------------------------------------------------------------------|
  | 6   | Цветомузыка (3/5 полос)       |     Кнопки * / # - Смена подрежима     | - повторное нажатие переключает режим 3/5 полос
  | 6.1 | 3 полосы                      | Плавность анимации | Чувствительность  |
  | 6.2 | 5 полос                       | Плавность анимации | Чувствительность  |
  |------------------------------------------------------------------------------|
  | 7   | Анализатор спектра            | Шаг цвета          | Цвет              |
  |------------------------------------------------------------------------------|
  | 8   | Цветовые эффекты NEW          |     Кнопки * / # - Смена подрежима     | - повтороное нажатие переключает способ "окрашивания"
  | 8.1 | Огоньки с краю                | Цвет               | Насыщенность      |
  | 8.2 | Огоньки из центра             | Цвет               | Насыщенность      |
  | 8.1 | Цветные полоски 1             | Цвет               | Насыщенность      |
  | 8.2 | Цветные полоски 2             | Цвет               | Насыщенность      |
  |------------------------------------------------------------------------------|        
  | 9   | Шкала громкости               |     Кнопки * / # - Смена подрежима     |
  | 9.1 | Градиент                      | Плавность анимации | -                 |
  | 9.2 | Радуга                        | Плавность анимации | Скорость радуги   |
  | 9.3 | Огонь                         | Плавность анимации | Цвет              |
  |------------------------------------------------------------------------------|
  |    Кнопка «ОК» - режим настроек     | Яркость горящих    | Яркость не горящих|
  |     (первые 8 диодов - радуга)      | Кнопки * и # - ручная настройка «шума» |
  | В режиме настроек кнопкой "0" переключается вход между MIC и LINE            |
  |------------------------------------------------------------------------------|
  |      Кнопка «ОК» 4 раза подряд      |                                        |
  |     в режимах цветомузыки (4-9)     |   Авто настройка нижнего порога шума   |
  |       в выключенном состоянии       |        Сброс настроек в памяти         |
  |------------------------------------------------------------------------------|
*/

#include "main.h"

void setup() {
  // --- Сброс/Восстановление настроек -------------------------------------------------------------------------
#if (KEEP_SETTINGS)
  if (EEPROM.read(101) != 101) {                // Если в 101 ячейке не 101 - сбрасываем настройки.
    EEPROM.write(101, 101);
    updateEEPROM();
  } else {                                      // Если нет - считываем настройки
    readEEPROM();
  }
#if (EEPROM_LOW_PASS)                           // Восстановить значения шумов из памяти
  LOW_PASS_mic = EEPROM.readInt(36);
  SPEKTR_LOW_PASS_mic = EEPROM.readInt(32);
  LOW_PASS_line = EEPROM.readInt(38);
  SPEKTR_LOW_PASS_line = EEPROM.readInt(34);
  MAX_COEF_FREQ_mic = EEPROM.readFloat(50);
  MAX_COEF_FREQ_line = EEPROM.readFloat(54);
#endif
#endif
  //============================================================================================================

#if (SETTINGS_LOG || REMOTE_LOG)
  Serial.begin(9600); // Запустить монитор порта
#endif

  FastLED.addLeds<WS2811, LED_PIN, GRB>(leds, NUM_LEDS).setCorrection(CORRECTION);
  if (CURRENT_LIMIT > 0) FastLED.setMaxPowerInVoltsAndMilliamps(5, CURRENT_LIMIT);

  pinMode(POT_GND, OUTPUT);
  digitalWrite(POT_GND, LOW);

  IRLremote.begin(IR_PIN);

#if (BUTTONS)                                 // Если кнопки включены
  btn_OnOff.setTimeout(400); 
  btn_RELAY.setTimeout(400);
#endif

#if (MONO_STEREO < 2)                         // Если микрофон использутся
  pinMode(RELAYon, OUTPUT);
  digitalWrite(RELAYon, line_mode); 
#endif

#if (INDICATE_LED)                            // Если индикация на диодах активна
  pinMode(LED_ON, OUTPUT); pinMode(LED_OFF, OUTPUT); pinMode(LED_line, OUTPUT); pinMode(LED_IR, OUTPUT);
  for (byte i = 0; i < 3; i++) {              // Помигаем светодиодами на передней панели
    digitalWrite(LED_OFF, HIGH); delay(100); digitalWrite(LED_OFF, LOW); delay(100);
    digitalWrite(LED_ON, HIGH); delay(100); digitalWrite(LED_ON, LOW); delay(100);
    digitalWrite(LED_line, HIGH); delay(100); digitalWrite(LED_line, LOW); delay(100);
    digitalWrite(LED_IR, HIGH); delay(100); digitalWrite(LED_IR, LOW); delay(100);
  }
  digitalWrite(LED_OFF, LOW); digitalWrite(LED_ON, HIGH); digitalWrite(LED_IR, LOW); digitalWrite(LED_line, line_mode); 
#endif

  // для увеличения точности уменьшаем опорное напряжение,
  // выставив EXTERNAL и подключив Aref к выходу 3.3V на плате через делитель
  // GND ---[10-20 кОм] --- REF --- [10 кОм] --- 3V3
  // в данной схеме GND берётся из А0 для удобства подключения
  if (POTENT) analogReference(EXTERNAL);
  else        analogReference(INTERNAL);

  // меняем частоту оцифровки до 18 кГц
  // поднимаем частоту опроса аналогового порта до 38.4 кГц, по теореме
  // Котельникова (Найквиста) частота дискретизации будет 19.2 кГц
  // http://yaab-arduino.blogspot.ru/2015/02/fast-sampling-from-analog-input.html
  sbi(ADCSRA, ADPS2);
  cbi(ADCSRA, ADPS1);
  sbi(ADCSRA, ADPS0);
}

void loop() {
#if BUTTONS                                     // Если кнопки активны
  buttonTick();                                 // Опрос и обработка кнопок
#endif
  remoteTick();                                 // Опрос ИК пульта
  eepromTick();                                 // Сохранить настройки  
  if (millis() - main_timer > MAIN_LOOP) {      // Главный цикл отрисовки
    main_timer = millis();                      // Сбросить таймер
    animation();                                // Запуск анимации
#if (INDICATE_STR)                              // Если индикация на ленте активна
    if (settings_mode) indicate();              // Индикация режима настроек
#endif
    FastLED.setBrightness(BRIGHTNESS);          // Установить яркость ленты
    if (!IRLremote.receiving()) FastLED.show(); // Если на ИК приёмник не приходит сигнал - отправить значения на ленту (без этого НЕ РАБОТАЕТ!)
  }
}
